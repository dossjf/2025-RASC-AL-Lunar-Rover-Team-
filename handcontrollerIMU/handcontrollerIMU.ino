#include <MPU6050_light.h>
#include <U8g2lib.h>
#include <Wire.h>
#include <WiFi.h>
#include <esp_wifi.h>
#include <esp_now.h>

U8G2_SSD1306_128X64_NONAME_F_HW_I2C u8g2(U8G2_R0, /* reset=*/ U8X8_PIN_NONE); //This is the particular setup for the screen.
MPU6050 mpu(Wire);
unsigned long timer = 0;

#define BUTTON_UP_PIN 3
#define BUTTON_DOWN_PIN 4
#define BUTTON_TRIG_PIN 5
#define PI 3.1415926535897932384626433832795

// VARIABLES //
// IMAGES //
static unsigned char loadingScreen[] = {
 0x00,0x00,0x00,0x00,0x00,0x00,0x00,0x00,0x00,0x00,0x00,0x00,
 0x00,0x00,0x00,0x00,0x00,0x00,0x00,0x00,0x00,0x00,0x00,0x00,
 0x00,0x00,0x00,0x00,0x00,0x00,0x00,0x00,0x00,0x00,0x00,0x00,
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 0x00,0x00,0x00,0x00,0x00,0x00,0x00,0x00};
static unsigned char mainScreen[] = {
 0x00,0x00,0x00,0x00,0x00,0x00,0x00,0x00,0x00,0x00,0x00,0x00,
 0x00,0x00,0x00,0x00,0x00,0x00,0x00,0x00,0x00,0x00,0x00,0x00,
 0x00,0x00,0x00,0x00,0x00,0x00,0x00,0x00,0xfc,0x81,0xff,0xff,
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 0x00,0x00,0x00,0x00};
// MENU //
int lastButtonUp = 0; 
int lastButtonDown = 0; 
int lastButtonTrig = 0; 
int buttonUp = 0;
int buttonDown = 0;
int buttonTrig = 0;
float startTime = 5000; //Defines how long the loading screen lasts for. Should be long enough to reliably connect to the other ESP.
char outputP[10];
char outputY[10];
char jointLabel[4];
char armLabel[2];
const int x0P = 28;
const int y0P = 37;
const int x0Y = 80;
const int y0Y = 37;
const int lineLength = 22;
int xP, yP;
int xY, yY;
float angleRad;
unsigned long runTime;
float boxLength = 54;
// JOINTS //
float jointPitch[5] = {0, 0, 0, 0, 0};
float jointYaw[5] = {0, 0, 0, 0, 0};
int jointSetNumber = 0;
int clawState = false;
// SENSOR //
float sensitivity = 0.1; //Controller rate sensitvity
float sensorInPitchDeg = 0;
float sensorInYawDeg = 0; 
float sensorInYawDegX = 0;
float sensorInPitchDegX = 0;
float currentJointPitch = 0;
float currentJointYaw = 0;
// WIFI // 
uint8_t broadcastAddress[] = {0x24, 0x6f, 0x28, 0x79, 0x17, 0x98};
typedef struct struct_message {
  float pitch;
  float yaw;
  int joint;
} struct_message;
struct_message myData;
esp_now_peer_info_t peerInfo;

void OnDataSent(const uint8_t *mac_addr, esp_now_send_status_t status) {
  Serial.print("\r\nLast Packet Send Status:\t");
  Serial.println(status == ESP_NOW_SEND_SUCCESS ? "Delivery Success" : "Delivery Fail");
}

void readMacAddress(){
  uint8_t baseMac[6];
  esp_err_t ret = esp_wifi_get_mac(WIFI_IF_STA, baseMac);
  if (ret == ESP_OK) {
    Serial.printf("%02x:%02x:%02x:%02x:%02x:%02x\n",
                  baseMac[0], baseMac[1], baseMac[2],
                  baseMac[3], baseMac[4], baseMac[5]);
  } else {
    Serial.println("Failed to read MAC address");
  }
}

void readButtons() { //Contains Command Information for the Grabber.
  buttonUp = (1-digitalRead(BUTTON_UP_PIN));
  buttonDown = (1-digitalRead(BUTTON_DOWN_PIN));
  buttonTrig = (1-digitalRead(BUTTON_TRIG_PIN));
  if (lastButtonUp == LOW && buttonUp == HIGH) {
    jointSetNumber++;
    if (jointSetNumber > 4) {
      jointSetNumber = 4;
    }
  }
  if (lastButtonDown == LOW && buttonDown == HIGH) {
    jointSetNumber--;
    if (jointSetNumber < 0) {
      jointSetNumber = 0;
    }
  }
  if (lastButtonTrig == LOW && buttonTrig == HIGH) {
    if(jointSetNumber == 4) {
      if(clawState == 1) {
        clawState = 0;
      } else if (clawState == 0) {
        clawState = 1;
      }
      jointPitch[jointSetNumber] = -90*clawState;
      jointYaw[jointSetNumber] = -90*clawState;
    }
  }

  lastButtonUp = buttonUp;
  lastButtonDown = buttonDown;
  lastButtonTrig = buttonTrig;

  if(buttonTrig && jointSetNumber != 0 && jointSetNumber != 4) {
    jointPitch[jointSetNumber] = constrain(jointPitch[jointSetNumber]-(sensorInPitchDeg*sensitivity),-90,90);
    jointYaw[jointSetNumber] = constrain(jointYaw[jointSetNumber]+(sensorInYawDeg*sensitivity),-90,90);
  }
}

void drawLoadingScreen() {
  u8g2.drawXBM(64-32, 32-32, 64, 64, loadingScreen);
  float boxRatio = runTime/startTime;
  float boxStep = boxRatio*boxLength;
  u8g2.drawBox(37,53,boxStep,6);
}

void calculateLineEndpoint(int startX, int startY, float angleDeg, int &endX, int &endY) {
  angleDeg = constrain(angleDeg, -90.0, 90.0);
  angleRad = -(angleDeg-90) * (PI / 180.0);
  endX = startX + lineLength * cos(angleRad);
  endY = startY - lineLength * sin(angleRad);
}

void drawScreen() {
  //Draw readout.
  currentJointPitch = jointPitch[jointSetNumber];
  currentJointYaw = jointYaw[jointSetNumber];
  if (currentJointPitch >= 0) {
    snprintf(outputP, sizeof(outputP), "+%.1f", currentJointPitch);
  } else {
    snprintf(outputP, sizeof(outputP), "%.1f", currentJointPitch);
  }
  if (currentJointYaw >= 0) {
    snprintf(outputY, sizeof(outputY), "+%.1f", currentJointYaw);
  } else {
    snprintf(outputY, sizeof(outputY), "%.1f", currentJointYaw);
  }

  if(jointSetNumber == 0) {
    strcpy(jointLabel, "-");
  } else if (jointSetNumber == 4) {
    strcpy(jointLabel, "G");
  } else {
    snprintf(jointLabel, sizeof(jointLabel), "%d", jointSetNumber);
  }

  if (buttonTrig == 0 || jointSetNumber == 0) {
    strcpy(armLabel, "S");
  } else {
    strcpy(armLabel, "A");
  }

  u8g2.drawXBM(0, 0, 128, 64, mainScreen);
  u8g2.setFont(u8g2_font_neuecraft_te);
  u8g2.setDrawColor(0);
  u8g2.drawStr(9,58,outputP);	//Pitch
  u8g2.drawStr(61,58,outputY);	//Yaw
  u8g2.setFont(u8g2_font_t0_22b_tf);
  u8g2.drawStr(113,17,armLabel);	//Arm State
  u8g2.setDrawColor(1);
  u8g2.setFont(u8g2_font_t0_22_tf);
  u8g2.drawStr(112,48,jointLabel);	//Selected Joint

  //Draw dial indicators.
  calculateLineEndpoint(x0P, y0P, -currentJointPitch, xP, yP);
  calculateLineEndpoint(x0Y, y0Y, currentJointYaw, xY, yY);
  u8g2.drawLine(x0P, y0P, xP, yP);
  u8g2.drawLine(x0Y, y0Y, xY, yY);

  if(jointSetNumber == 0) {
    u8g2.drawBox(4,4,101,56);
    u8g2.setDrawColor(0);
    u8g2.drawBox(7,7,95,50);
    u8g2.setDrawColor(1);
    u8g2.drawStr(22,28,"SYSTEM");
    u8g2.drawStr(10,47,"DISARMED");
  }
  if(jointSetNumber == 4) {
    u8g2.drawBox(4,4,101,56);
    u8g2.setDrawColor(0);
    u8g2.drawBox(7,7,95,50);
    u8g2.setDrawColor(1);
    u8g2.drawStr(16,28,"PRL-JAW");
    if(currentJointPitch == 0) {
      u8g2.drawStr(10,47,"INACTIVE");
    } else {
      u8g2.drawStr(22,47,"ACTIVE");
    }
  }
}

void setup() {
  pinMode(BUTTON_UP_PIN, INPUT_PULLUP); // up button
  pinMode(BUTTON_TRIG_PIN, INPUT_PULLUP); // select button
  pinMode(BUTTON_DOWN_PIN, INPUT_PULLUP); // down button
  Serial.begin(115200);
  u8g2.begin();

  WiFi.mode(WIFI_STA);
  //WiFi.STA.begin(); //Uncomment this to enable read your MAC address.
  //Serial.print("[DEFAULT] ESP32 Board MAC Address: ");
  //readMacAddress();
  if (esp_now_init() != ESP_OK) {
    Serial.println("Error initializing ESP-NOW");
    return;
  }
  esp_now_register_send_cb(OnDataSent);
  memcpy(peerInfo.peer_addr, broadcastAddress, 6);
  peerInfo.channel = 0;  
  peerInfo.encrypt = false;
  if (esp_now_add_peer(&peerInfo) != ESP_OK){
    Serial.println("Failed to add peer");
    return;
  }

  byte status = mpu.begin();
  Serial.print(F("MPU6050 status: "));
  Serial.println(status);
  while(status!=0){ } // stop everything if could not connect to MPU6050
  
  Serial.println(F("Calculating offsets, do not move MPU6050"));
  delay(1000);
  // mpu.upsideDownMounting = true; // uncomment this line if the MPU6050 is mounted upside-down
  mpu.calcOffsets(); // gyro and accelero
  Serial.println("Done!\n");
}

void loop() {
  runTime = millis();
  mpu.update();
  u8g2.clearBuffer();
  if(runTime < startTime) {
    drawLoadingScreen();
  } else {
    sensorInYawDegX = constrain(-mpu.getAngleX(),-90,90);
    if(sensorInYawDegX >= 0) {
      sensorInYawDeg = 90*((sensorInYawDegX/90)*(sensorInYawDegX/90)); //applies expo curves to inputs.
    } else {
      sensorInYawDeg = -90*((sensorInYawDegX/90)*(sensorInYawDegX/90));
    }
    sensorInPitchDegX = constrain(mpu.getAngleY(),-90,90);
    if(sensorInPitchDegX >= 0) {
      sensorInPitchDeg = 90*((sensorInPitchDegX/90)*(sensorInPitchDegX/90)); //applies expo curves to inputs.
    } else {
      sensorInPitchDeg = -90*((sensorInPitchDegX/90)*(sensorInPitchDegX/90));
    }
    readButtons();
    drawScreen();
  }
  u8g2.sendBuffer();

  myData.pitch = currentJointPitch;
  myData.yaw = currentJointYaw;
  myData.joint = jointSetNumber;
  esp_err_t result = esp_now_send(broadcastAddress, (uint8_t *) &myData, sizeof(myData));
  if (result == ESP_OK) {
    Serial.println("Sent with success");
  }
  else {
    Serial.println("Error sending the data");
  }
}
